#include "Cardinal.dtsi"

&kscan0 {
    wakeup-source;
    col-gpios
        = <&xiao_d 10 GPIO_ACTIVE_HIGH>
        , <&xiao_d 9  GPIO_ACTIVE_HIGH>
        , <&xiao_d 8  GPIO_ACTIVE_HIGH>
        , <&xiao_d 7  GPIO_ACTIVE_HIGH>
        , <&gpio0  10 GPIO_ACTIVE_HIGH>
        , <&gpio0  9  GPIO_ACTIVE_HIGH>
        ;
};

&left_encoder {
    status = "okay";
};

&sensors {
    status = "okay";
};

/* 〈Fractlight Recalibration〉— 左手固有のバッテリー%キャリブレーション補正。
 * 右手(Elucidator)は満充電付近で98%前後まで正常に上がる一方、左手は
 * 充電LEDが消灯（＝充電回路的にはフル充電完了）していても50%で頭打ちに
 * なる症状を確認。xiao_ble共通ボード定義の &vbatt（output-ohms=510000 /
 * full-ohms=1510000）はあくまで公称値で、ADC内部基準電圧・分圧抵抗の
 * 個体差までは補正しない。battery_common.c の変換式
 * `percent = mv*2/15 - 459` から逆算すると、現在の50%表示は内部的に
 * 約3817.5mVと計算されている状態。実際は満充電（LiPo標準4200mV）のはず
 * のため、その比率差から output-ohms を再計算して補正する：
 *   現分圧比 1510000/510000 ≈ 2.9608 → 補正後 4200/3817.5×2.9608 ≈ 3.2574
 *   output-ohms = 1000000 / (3.2574-1) ≈ 443000
 * テスター未使用・充電LED消灯という間接確認のみに基づく概算補正のため、
 * 実測（テスターや実際の%推移）で乖離が分かれば数値を再調整すること。
 */
&vbatt {
    output-ohms = <443000>;
    full-ohms = <(443000 + 1000000)>;
};
