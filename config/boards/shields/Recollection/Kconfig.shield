## config/boards/shields/Recollection/Kconfig.shield
```kconfig
config SHIELD_ELUCIDATOR
    def_bool $(shields_list_contains,Elucidator)

config SHIELD_DARK_REPULSER
    def_bool $(shields_list_contains,Dark_Repulser)
```

## config/boards/shields/Release_Recollection/Kconfig.defconfig
```kconfig
if SHIELD_ELUCIDATOR

config ZMK_KEYBOARD_NAME
    default "Elucidator"

config ZMK_SPLIT
    default y

config ZMK_SPLIT_ROLE_CENTRAL
    default y

endif

if SHIELD_DARK_REPULSER

config ZMK_KEYBOARD_NAME
    default "Dark Repulser"

config ZMK_SPLIT
    default y

endif
```
