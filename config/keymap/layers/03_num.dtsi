/* ============================================================
 * layers/03_num.dtsi — [ Synthesis 03 ] NUM
 * ============================================================ */

NUM {
    bindings = <
    &trans  &kp LA(LC(V))  &kp LG(LS(NUMBER_3))  &kp LG(LS(NUMBER_4))  &trans  &kp KP_NUMBER_1  &kp KP_NUMBER_2  &kp KP_NUMBER_3  &kp KP_NUMBER_4  &kp KP_NUMBER_5  &kp LG(A)  &kp LG(X)  &kp LG(C)  &kp LG(V)  &kp END  &trans  &kp EQUAL  &kp KP_NUMBER_6  &kp KP_NUMBER_7  &kp KP_NUMBER_8  &kp KP_NUMBER_9  &kp KP_NUMBER_0  &trans  &trans  &kp LG(Z)  &kp LG(Y)  &trans  &trans  &kp LS(EQUAL)  &kp MINUS  &kp LS(NUMBER_8)  &kp SLASH  &kp PERIOD  &kp COMMA  &trans  &trans  &trans  &trans  &trans  &trans  &kp BACKSPACE  &kp ENTER  &kp RG(Z)
    >;

    sensor-bindings = <&inc_dec_kp C_BRI_DN C_BRI_UP>;
};
